## conf/layer.conf
```bitbake
BBFILES += "${LAYERDIR}/recipes/*/*.bb ${LAYERDIR}/recipes/*/*.bbappend ${LAYERDIR}/recipes-*/*/*.bb ${LAYERDIR}/recipes-*/*/*.bbappend"
BBPATH .= ":${LAYERDIR}"
BBFILE_COLLECTIONS += "meta-audioreach"
BBFILE_PRIORITY_meta-audioreach = "17"
BBFILE_PATTERN_meta-audioreach := "^${LAYERDIR}/"

LAYERSERIES_COMPAT_meta-audioreach = "kirkstone scarthgap"
```
